## prj.conf
```kconfig
# nothing here
CONFIG_SCHED_MULTIQ=y
CONFIG_NETWORKING=y
CONFIG_TEST_RANDOM_GENERATOR=y

CONFIG_NET_TX_STACK_SIZE=2048
CONFIG_NET_RX_STACK_SIZE=2048

CONFIG_NET_PKT_RX_COUNT=10
CONFIG_NET_PKT_TX_COUNT=10
CONFIG_NET_BUF_RX_COUNT=20
CONFIG_NET_BUF_TX_COUNT=20
CONFIG_NET_MAX_CONTEXTS=10

CONFIG_NET_IPV4=y
CONFIG_NET_IPV6=n

CONFIG_NET_LOG=y
CONFIG_SYS_LOG_NET_LEVEL=1
CONFIG_SYS_LOG_SHOW_COLOR=y
CONFIG_INIT_STACKS=y

CONFIG_UART_MCUX=y
CONFIG_UART_MCUX_1=y

CONFIG_UART_INTERRUPT_DRIVEN=y
CONFIG_HW_STACK_PROTECTION=y

CONFIG_MAIN_STACK_SIZE=4096
CONFIG_IDLE_STACK_SIZE=1024
CONFIG_ISR_STACK_SIZE=1024
CONFIG_NEWLIB_LIBC=y
CONFIG_GPIO=y
```

## src/main.c
```c
/*
 * Copyright (c) 2012-2014 Wind River Systems, Inc.
 *
 * SPDX-License-Identifier: Apache-2.0
 */

#include <zephyr.h>
#include <misc/printk.h>

static K_THREAD_STACK_DEFINE(stack0, 1024);
static K_THREAD_STACK_DEFINE(stack1, 1024);
static struct k_thread __kernel thread0;
static struct k_thread __kernel thread1;

volatile char tbuffer[400];

void print_stuff(void *id, void * unused1, void *unused2)
{
	ARG_UNUSED(id);
	ARG_UNUSED(unused1);
	ARG_UNUSED(unused2);

	while (1) {
		printk("%d: foo\n", (u32_t) id);
                tbuffer[0] = (u32_t)id;
		k_sleep(1000);
	}
}

void main(void)
{
	k_thread_create(&thread0, stack0, 1024, print_stuff, (void *)0,
			NULL, NULL, 5, K_USER, K_FOREVER);
	k_thread_create(&thread1, stack1, 1024, print_stuff, (void *)1,
			NULL, NULL, 5, K_USER, K_FOREVER);

	k_thread_start(&thread0);
	k_thread_start(&thread1);
}
```
