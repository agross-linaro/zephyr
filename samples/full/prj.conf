## prj.conf
```kconfig
CONFIG_NETWORKING=y
CONFIG_NET_IPV6=n
CONFIG_NET_IPV4=y
CONFIG_NET_ARP=y
CONFIG_NET_UDP=y
CONFIG_NET_DHCPV4=y

CONFIG_JWT=y

CONFIG_NET_PKT_RX_COUNT=4
CONFIG_NET_PKT_TX_COUNT=4
CONFIG_NET_BUF_RX_COUNT=16
CONFIG_NET_BUF_TX_COUNT=16

CONFIG_TEST_RANDOM_GENERATOR=y

CONFIG_INIT_STACKS=y

CONFIG_NET_MGMT=y
CONFIG_NET_MGMT_EVENT=y

CONFIG_NET_LOG=y
CONFIG_SYS_LOG=y
CONFIG_SYS_LOG_NET_LEVEL=4
CONFIG_SYS_LOG_SHOW_COLOR=y

CONFIG_NET_DEBUG_CORE=n
CONFIG_NET_DEBUG_IF=n
CONFIG_NET_DEBUG_IPV4=n
CONFIG_NET_DEBUG_UDP=n
CONFIG_NET_DEBUG_DHCPV4=n
CONFIG_NET_DEBUG_CONN=n
CONFIG_NET_DEBUG_ARP=n
CONFIG_NET_DEBUG_L2_ETHERNET=n

# This shouldn't need to be set, but isn't selected properly.
CONFIG_NEWLIB_LIBC=y
CONFIG_DNS_SERVER_IP_ADDRESSES=y
CONFIG_DNS_SERVER1="8.8.8.8"

CONFIG_DNS_RESOLVER=y
CONFIG_SNTP=y

CONFIG_SLIP_STATISTICS=n

CONFIG_HW_STACK_PROTECTION=y
CONFIG_MAIN_STACK_SIZE=16384

CONFIG_MBEDTLS_SSL_MAX_CONTENT_LEN=16384

CONFIG_DEBUG_OPTIMIZATIONS=y
CONFIG_TEST_RANDOM_GENERATOR=n

CONFIG_PTHREAD_IPC=y
CONFIG_NET_SOCKETS=y

# Enable MBEDTLS
CONFIG_MBEDTLS=y
CONFIG_MBEDTLS_BUILTIN=y
CONFIG_MBEDTLS_CFG_FILE="config-full-mqtt.h"
```

## prj_frdm_k64f.conf
```kconfig
CONFIG_NETWORKING=y
CONFIG_NET_IPV6=n
CONFIG_NET_IPV4=y
CONFIG_NET_ARP=y
CONFIG_NET_UDP=y
CONFIG_NET_TCP=y
CONFIG_NET_DHCPV4=n
# CONFIG_NETWORKING_WITH_TCP=y
# CONFIG_NETWORKING_WITH_IPV4=y
CONFIG_NET_SOCKETS=y
CONFIG_JWT=y
CONFIG_JWT_SIGN_ECDSA=y

CONFIG_HW_STACK_PROTECTION=y
CONFIG_MAIN_STACK_SIZE=4096

CONFIG_MBEDTLS_SSL_MAX_CONTENT_LEN=16384
CONFIG_MBEDTLS_DEBUG_LEVEL=0


# For debugging
CONFIG_DEBUG_OPTIMIZATIONS=y

# CONFIG_IP_BUF_RX_SIZE=4
# CONFIG_IP_BUF_TX_SIZE=4

CONFIG_NET_PKT_RX_COUNT=4
CONFIG_NET_PKT_TX_COUNT=4
CONFIG_NET_BUF_RX_COUNT=16
CONFIG_NET_BUF_TX_COUNT=16

# _NEVER EVER SET THIS_
CONFIG_TEST_RANDOM_GENERATOR=n

CONFIG_INIT_STACKS=y

CONFIG_NET_MGMT=y
CONFIG_NET_MGMT_EVENT=y

CONFIG_NET_LOG=y
CONFIG_SYS_LOG=y
CONFIG_SYS_LOG_NET_LEVEL=4
CONFIG_SYS_LOG_SHOW_COLOR=y

CONFIG_NET_DEBUG_CORE=n
CONFIG_NET_DEBUG_IF=n
CONFIG_NET_DEBUG_IPV4=n
CONFIG_NET_DEBUG_UDP=n
CONFIG_NET_DEBUG_DHCPV4=n
CONFIG_NET_DEBUG_CONN=n
CONFIG_NET_DEBUG_ARP=n
CONFIG_NET_DEBUG_L2_ETHERNET=n
CONFIG_NET_DEBUG_NET_PKT=n

CONFIG_DNS_RESOLVER=y
CONFIG_SNTP=y

# This shouldn't need to be set, but isn't selected properly.
CONFIG_NET_APP=y
CONFIG_NEWLIB_LIBC=y
CONFIG_DNS_SERVER_IP_ADDRESSES=y
CONFIG_DNS_SERVER1="8.8.8.8"

CONFIG_PTHREAD_IPC=y
CONFIG_NET_SOCKETS=y

# Enable MBEDTLS
CONFIG_MBEDTLS=y
CONFIG_MBEDTLS_BUILTIN=y
CONFIG_MBEDTLS_CFG_FILE="config-full-mqtt.h"
```

## src/main.c
```c
/* Full-stack IoT client example. */

/*
 * Copyright (c) 2018 Linaro Ltd
 *
 * SPDX-License-Identifier: Apache-2.0
 */

#define SYS_LOG_LEVEL SYS_LOG_LEVEL_DEBUG

#include <zephyr.h>
#include <logging/sys_log.h>

#include "dhcp.h"
#include "dns.h"
#include "protocol.h"

#include <net/sntp.h>
#include <net/net_config.h>
#include <net/net_event.h>

/* This comes from newlib. */
#include <time.h>
#include <inttypes.h>

#ifdef CONFIG_STDOUT_CONSOLE
# include <stdio.h>
# define PRINT printf
#else
# define PRINT printk
#endif

#include "net/wifi_mgmt.h"

struct k_sem sem;

#define SNTP_PORT 123

static int64_t time_base;

void resp_callback(struct sntp_ctx *ctx,
		   int status,
		   u64_t epoch_time,
		   void *user_data)
{
	int64_t stamp;

	stamp = k_uptime_get();
	SYS_LOG_INF("stamp: %lld", stamp);
	SYS_LOG_INF("time: %lld", epoch_time);
	SYS_LOG_INF("time1k: %lld", epoch_time * MSEC_PER_SEC);
	time_base = epoch_time * MSEC_PER_SEC - stamp;
	SYS_LOG_INF("base: %lld", time_base);
	SYS_LOG_INF("status: %d", status);

	/* Convert time to make sure. */
	time_t now = epoch_time;
	struct tm now_tm;

	gmtime_r(&now, &now_tm);
	SYS_LOG_INF("  year: %d", now_tm.tm_year);
	SYS_LOG_INF("  mon : %d", now_tm.tm_mon);
	SYS_LOG_INF("  day : %d", now_tm.tm_mday);
	SYS_LOG_INF("  hour: %d", now_tm.tm_hour);
	SYS_LOG_INF("  min : %d", now_tm.tm_min);
	SYS_LOG_INF("  sec : %d", now_tm.tm_sec);

	k_sem_give(&sem);
}

/* Zephyr implementation of POSIX `time`.  Has to be called k_time
 * because time is already taken by newlib.  The clock will be set by
 * the SNTP client when it receives the time.  We make no attempt to
 * adjust it smoothly, and it should not be used for measuring
 * intervals.  Use `k_uptime_get()` directly for that.   Also the
 * time_t defined by newlib is a signed 32-bit value, and will
 * overflow in 2037. */
time_t k_time(time_t *ptr)
{
	s64_t stamp;
	time_t now;

	stamp = k_uptime_get();
	now = (time_t)((stamp + time_base) / 1000);

	if (ptr) {
		*ptr = now;
	}

	return now;
}

void sntp(const char *ip)
{
	struct sntp_ctx ctx;
	int rc;

	k_sem_init(&sem, 0, 1);

	/* Initialize sntp */
	rc = sntp_init(&ctx,
		       ip,
		       SNTP_PORT,
		       K_FOREVER);
	if (rc < 0) {
		SYS_LOG_ERR("Unable to init sntp context: %d", rc);
		return;
	}

	rc = sntp_request(&ctx, K_FOREVER, resp_callback, NULL);
	if (rc < 0) {
		SYS_LOG_ERR("Failed to send sntp request: %d", rc);
		return;
	}

	/* TODO: This needs to retry. */
	k_sem_take(&sem, K_FOREVER);
	sntp_close(&ctx);

	SYS_LOG_INF("done");
}

#if defined (CONFIG_WIFI_ESP8266)
static struct net_mgmt_event_callback wifi_mgmt_cb;
static struct net_mgmt_event_callback dhcp_mgmt_cb;
static K_SEM_DEFINE(sem_comm, 0, 1);
static K_SEM_DEFINE(sem_ip, 0, 1);

static void handle_wifi_connect_result(struct net_mgmt_event_callback *cb,
	struct net_if *iface)
{
	const struct wifi_status *status =
			(const struct wifi_status *) cb->info;

	if (status->status) {
		printk("\nConnection request failed (%d)\n", status->status);
	} else {
		printk("\nConnected\n");
	}
}

static void dhcp_event_handler(struct net_mgmt_event_callback *cb,
                                   u32_t mgmt_event, struct net_if *iface)
{
	switch (mgmt_event) {
	case NET_EVENT_IPV4_ADDR_ADD:
		k_sem_give(&sem_ip);
		break;
	default:
		break;
	}
}

static void wifi_mgmt_event_handler(struct net_mgmt_event_callback *cb,
	u32_t mgmt_event, struct net_if *iface)
{
	switch (mgmt_event) {
	case NET_EVENT_WIFI_CONNECT_RESULT:
		handle_wifi_connect_result(cb, iface);
		k_sem_give(&sem_comm);
		break;
	default:
		break;
	}
}

static const char ssid[] = "ATT8QEU2Fm";
static const char psk[] = "2142079019";

void start_esp8266(void)
{
	struct net_if *iface = net_if_get_default();
	static struct wifi_connect_req_params esp8266_params;
	char buf[NET_IPV4_ADDR_LEN];

	net_mgmt_init_event_callback(&wifi_mgmt_cb,
		wifi_mgmt_event_handler,
		NET_EVENT_WIFI_CONNECT_RESULT |
		NET_EVENT_WIFI_DISCONNECT_RESULT);

	net_mgmt_add_event_callback(&wifi_mgmt_cb);

	net_mgmt_init_event_callback(&dhcp_mgmt_cb, dhcp_event_handler,
		NET_EVENT_IPV4_ADDR_ADD);
	net_mgmt_add_event_callback(&dhcp_mgmt_cb);

	esp8266_params.ssid = ssid;
	esp8266_params.ssid_length = strlen(ssid);
	esp8266_params.psk = psk;
	esp8266_params.psk_length = strlen(psk);
	esp8266_params.security = WIFI_SECURITY_TYPE_PSK;

	net_mgmt(NET_REQUEST_WIFI_DISCONNECT, iface, NULL, NULL);

	printk("%p is your iface\n", iface);
	if (net_mgmt(NET_REQUEST_WIFI_CONNECT, iface, &esp8266_params,
		sizeof(struct wifi_connect_req_params))) {
		printk("Connection request failed\n");
		return;
	}

	if (k_sem_take(&sem_comm, 10000)) {
		printk("timeout out connecting to AP: %s\n",
		esp8266_params.ssid);
		return;
	}

	if (k_sem_take(&sem_ip, 10000)) {
		printk("timeout out waiting for ip address\n");
		return;
	}

	printk("DHCP address from ESP8266:\n");
	printk("ip: %s\n",
		net_addr_ntop(AF_INET,
		&iface->config.ip.ipv4->unicast[0].address.in_addr,
		buf, sizeof(buf)));
	printk("gw: %s\n",
		net_addr_ntop(AF_INET,
		&iface->config.ip.ipv4->gw,
		buf, sizeof(buf)));
	printk("netmask: %s\n",
		net_addr_ntop(AF_INET,
		&iface->config.ip.ipv4->netmask,
		buf, sizeof(buf)));
}
#endif



/*
 * TODO: These need to be configurable.
 */
#define MBEDTLS_NETWORK_TIMEOUT 30000

static void show_addrinfo(struct zsock_addrinfo *addr)
{
top:
	printf("  flags   : %d\n", addr->ai_flags);
	printf("  family  : %d\n", addr->ai_family);
	printf("  socktype: %d\n", addr->ai_socktype);
	printf("  protocol: %d\n", addr->ai_protocol);
	printf("  addrlen : %d\n", addr->ai_addrlen);

	/* Assume two words. */
	printf("   addr[0]: 0x%lx\n", ((uint32_t *)addr->ai_addr)[0]);
	printf("   addr[1]: 0x%lx\n", ((uint32_t *)addr->ai_addr)[1]);

	if (addr->ai_next != 0) {
		addr = addr->ai_next;
		goto top;
	}
}

/*
 * Things that make sense in a demo app that would need to be more
 * robust in a real application:
 *
 * - DHCP happens once.  If it fails, or we change networks, the
 *   network will just stop working.
 *
 * - DNS lookups are tried once, and that address just used.  IP
 *   address changes, or DNS resolver problems will just break the
 *   demo.
 */

void main(void)
{
	char time_ip[NET_IPV6_ADDR_LEN];
	static struct zsock_addrinfo hints;
	struct zsock_addrinfo *haddr;
	int res;

	SYS_LOG_INF("Main entered");

#if defined(CONFIG_WIFI_OFFLOAD)
	k_sleep(5000);
	start_esp8266();
#else
	app_dhcpv4_startup();
#endif

	SYS_LOG_INF("Should have DHCPv4 lease at this point.");

	res = ipv4_lookup("time.google.com", time_ip, sizeof(time_ip));
	if (res == 0) {
		SYS_LOG_INF("time: %s", time_ip);
	} else {
		SYS_LOG_INF("Unable to lookup time.google.com, stopping");
		return;
	}

	SYS_LOG_INF("Done with DNS");

	/* TODO: Convert sntp to sockets with newer API. */
	sntp(time_ip);

	printk("sntp finished\n");
	/* After setting the time, spin periodically, and make sure
	 * the system clock keeps up reasonably.
	 */
	for (int count = 0; count < 0; count++) {
		time_t now;
		struct tm tm;
		uint32_t a, b, c;

		a = k_cycle_get_32();
		now = k_time(NULL);
		b = k_cycle_get_32();
		gmtime_r(&now, &tm);
		c = k_cycle_get_32();

		SYS_LOG_INF("time %d-%d-%d %d:%d:%d",
			    tm.tm_year + 1900,
			    tm.tm_mon + 1,
			    tm.tm_mday,
			    tm.tm_hour,
			    tm.tm_min,
			    tm.tm_sec);
		SYS_LOG_INF("time k_time(): %lu", b - a);
		SYS_LOG_INF("time gmtime_r(): %lu", c - b);

		k_sleep(990);
	}

	hints.ai_family = AF_INET;
	hints.ai_socktype = SOCK_STREAM;
	hints.ai_protocol = 0;
	res = zsock_getaddrinfo("mqtt.googleapis.com", "8883", &hints, &haddr);
	printf("getaddrinfo status: %d\n", res);

	if (res != 0) {
		printf("Unable to get address, exiting\n");
		return;
	}

	show_addrinfo(haddr);

	tls_client("mqtt.googleapis.com", haddr, 8883);
	mqtt_startup();
}
```

## src/dhcp.c
```c
/* DHCPv4 client startup. */

/*
 * Copyright (c) 2018 Linaro Ltd
 *
 * SPDX-License-Identifier: Apache-2.0
 */

#define SYS_LOG_LEVEL SYS_LOG_LEVEL_DEBUG

#include <zephyr.h>
#include <logging/sys_log.h>

#include <net/net_if.h>
#include <net/net_core.h>
#include <net/net_context.h>
#include <net/net_mgmt.h>

static struct net_mgmt_event_callback mgmt_cb;

/* Semaphore to indicate a lease has been aquired. */
static K_SEM_DEFINE(got_address, 0, 1);

static void handler(struct net_mgmt_event_callback *cb,
		    u32_t mgmt_event,
		    struct net_if *iface)
{
	int i;
	bool notified = false;

	if (mgmt_event != NET_EVENT_IPV4_ADDR_ADD) {
		return;
	}

	for (i = 0; i < NET_IF_MAX_IPV4_ADDR; i++) {
		char buf[NET_IPV4_ADDR_LEN];

		if (iface->config.ip.ipv4->unicast[i].addr_type !=
		    NET_ADDR_DHCP) {
			continue;
		}

		/* TODO: IPv6 can get addresses through
		 * NET_ADDR_AUTOCONF. */

		SYS_LOG_INF("Your address: %s",
			    net_addr_ntop(AF_INET,
					  &iface->config.ip.ipv4->unicast[i].address.in_addr,
					  buf, sizeof(buf)));

		SYS_LOG_INF("netmask: %s",
			    net_addr_ntop(AF_INET,
			    &iface->config.ip.ipv4->netmask,
			    buf, sizeof(buf)));

		SYS_LOG_INF("gateway: %s",
			    net_addr_ntop(AF_INET,
			    &iface->config.ip.ipv4->gw,
			    buf, sizeof(buf)));

		if (!notified) {
			k_sem_give(&got_address);
			notified = true;
		}
		break;
	}
}

/**
 * Start a DHCP client, and wait for a lease to be aquired.
 */
void app_dhcpv4_startup(void)
{
	struct net_if *iface;
	SYS_LOG_INF("starting DHCPv4");

	net_mgmt_init_event_callback(&mgmt_cb, handler,
				     NET_EVENT_IPV4_ADDR_ADD);
	net_mgmt_add_event_callback(&mgmt_cb);

	iface = net_if_get_default();

	net_dhcpv4_start(iface);

	/* Wait for a lease. */
	k_sem_take(&got_address, K_FOREVER);
}
```

## src/dns.c
```c
/* DNS resolution. */

/*
 * Copyright (c) 2018 Linaro Ltd
 *
 * SPDX-License-Identifier: Apache-2.0
 */

#define SYS_LOG_LEVEL SYS_LOG_LEVEL_DEBUG

#include <zephyr.h>
#include <logging/sys_log.h>

#include <net/net_if.h>
#include <net/net_core.h>
#include <net/net_context.h>
#include <net/net_mgmt.h>
#include <net/dns_resolve.h>

#include "dns.h"

#define DNS_TIMEOUT K_SECONDS(2)

static K_SEM_DEFINE(dns_sem, 0, 1);

/* The 'user_data' passed back to the context.  Filled in with the
 * first name the resolver finds. */
struct dns_ctx {
	char *name;
	size_t name_len;
	bool filled;
	int status;
};

void dns_result_cb(enum dns_resolve_status status,
		   struct dns_addrinfo *info,
		   void *user_data)
{
	void *addr;
	struct dns_ctx *ctx = (struct dns_ctx *)user_data;

	SYS_LOG_INF("dns result: status=%d", status);

	switch (status) {
	case DNS_EAI_CANCELED:
		SYS_LOG_INF("DNS query canceled");
		ctx->status = status;
		k_sem_give(&dns_sem);
		return;
	case DNS_EAI_FAIL:
		SYS_LOG_INF("DNS resolve failed");
		ctx->status = status;
		k_sem_give(&dns_sem);
		return;
	case DNS_EAI_NODATA:
		SYS_LOG_INF("Cannot resolve address");
		ctx->status = status;
		k_sem_give(&dns_sem);
		return;
	case DNS_EAI_ALLDONE:
		SYS_LOG_INF("DNS resolving finished");
		ctx->status = 0;
		k_sem_give(&dns_sem);
		return;
	case DNS_EAI_INPROGRESS:
		SYS_LOG_INF("progress");
		break;
	default:
		SYS_LOG_INF("DNS resolve error (%d)", status);
		ctx->status = status;
		k_sem_give(&dns_sem);
		return;
	}

	if (!info) {
		return;
	}

	if (info->ai_family == AF_INET) {
		addr = &net_sin(&info->ai_addr)->sin_addr;
	} else {
		SYS_LOG_ERR("Unknown DNS result family %d", info->ai_family);
		return;
	}

	if (ctx->filled) {
		return;
	}

	ctx->filled = true;

	SYS_LOG_INF("IPv4 address: %s", net_addr_ntop(info->ai_family, addr,
						      ctx->name, ctx->name_len));
}

static const char foo[] = "8.8.8.8";
/* Returns 0 on success, or some kind of error otherwise. */
int ipv4_lookup(const char *host, char *ip, size_t ip_len)
{
	u16_t dns_id;
	int ret;
	struct dns_ctx context;
       struct dns_resolve_context *dns_ctx;
       static const char *server[2];
       server[0] = foo;
       server[1] = NULL;
       dns_ctx = dns_resolve_get_default();
       dns_resolve_init(dns_ctx, server, NULL);

	context.name = ip;
	context.name_len = ip_len;
	context.filled = false;

	ret = dns_get_addr_info(host,
				DNS_QUERY_TYPE_A,
				&dns_id,
				dns_result_cb,
				(void *)&context,
				DNS_TIMEOUT);
	if (ret < 0) {
		SYS_LOG_ERR("cannot resolve IPv4 address (%d)", ret);
		return ret;
	}

	k_sem_take(&dns_sem, K_FOREVER);

	return context.status;
}
```

## src/dns.h
```c
/* DNS queries. */

/*
 * Copyright (c) 2018 Linaro Ltd
 *
 * SPDX-License-Identifier: Apache-2.0
 */

#ifndef __DNS_H__
#define __DNS_H__

int ipv4_lookup(const char *host, char *ip, size_t ip_len);

#endif /* __DNS_H__ */
```

## src/mqtt.h
```c
/*
 * Copyright (c) 2018 Linaro Ltd
 *
 * SPDX-License-Identifier: Apache-2.0
 */

/*
 * Simplistic MQTT driver.
 *
 * The existing Zephyr MQTT code is divided into mqtt_pkt, which has
 * been copied to this directory, and the plain mqtt.c driver, which
 * is based on the netbuf code.  Since we need to use TLS, this is a
 * different driver that uses the same code for assembling and
 * processing packegs.
 */

#ifndef SAMPLE_MQTT_H__
#define SAMPLE_MQTT_H__

#include <net/mqtt_types.h>
#include "mqtt_pkt.h"

#endif
```

## src/pdump.c
```c
/**********************************************************************
 * pdump.c
 *
 * Debugging dump.
 */

#include <stdio.h>
#include <zephyr.h>
#include "pdump.h"
#include <ctype.h>

#define PRINTABLE(x) (isprint(x) ? (x) : '.')

void
pdump(const void *ibuffer, int length)
{
	static char line[80];
	static char ascii[18];
	int offset = 0;
	int ascii_offset = 0;
	unsigned char *buffer = (unsigned char *)ibuffer;
	int i;

	offset = 0;

	if (length == 0)
		return;

	ascii_offset = 0;

	for (i = 0; i < length; i++) {
		if ((i & 15) == 0) {
			if (i > 0) {
				ascii[ascii_offset] = 0;
				printk("%-60s %s\n", line, ascii);
				offset = 0;
				ascii_offset = 0;
			}
			offset += sprintf(line+offset, "%08x", i);
		} else if ((i & 7) == 0) {
			// offset += sprintf(line+offset, " -");
			// ascii[ascii_offset++] = ' ';
		}
		offset += sprintf(line+offset, " %02x", buffer[i] & 0xFF);
		ascii[ascii_offset++] = PRINTABLE (buffer[i] & 0xFF);
	}
	ascii[ascii_offset] = 0;
	printk("%-60s %s\n", line, ascii);
	offset = 0;
}
```

## src/protocol.c
```c
/* Protocol implementation. */
/*
 * Copyright (c) 2018 Linaro Ltd
 *
 * SPDX-License-Identifier: Apache-2.0
 */

#define SYS_LOG_LEVEL SYS_LOG_LEVEL_DEBUG

#include "protocol.h"

#include <zephyr.h>
#include <logging/sys_log.h>
#include <string.h>
#include <jwt.h>

#include "mqtt.h"
#include "pdump.h"

#include <mbedtls/platform.h>
#include <mbedtls/net.h>
#include <mbedtls/ssl.h>
#include <mbedtls/entropy.h>
#include <mbedtls/ctr_drbg.h>

#include <mbedtls/debug.h>

#ifdef CONFIG_STDOUT_CONSOLE
# include <stdio.h>
# define PRINT printf
#else
# define PRINT printk
#endif

static unsigned char zepfull_ec_private_der[] = {
	0x4c, 0x77, 0xb9, 0x99, 0x2d, 0x9d, 0x9f, 0x4d,
	0xd9, 0x67, 0x34, 0xc5, 0x33, 0x72, 0x86, 0x3a,
	0x98, 0x1f, 0xf1, 0xe5, 0xbd, 0x20, 0xdb, 0x9e,
	0x12, 0xcb, 0x43, 0xf8, 0xad, 0xba, 0x56, 0xa9,
};
unsigned int zepfull_ec_private_der_len = 32;


/*
 * TODO: Properly export these.
 */
time_t k_time(time_t *ptr);

/*
 * mbed TLS has its own "memory buffer alloc" heap, but it needs some
 * data.  This size can be tuned.
 */
#ifdef MBEDTLS_MEMORY_BUFFER_ALLOC_C
#  include <mbedtls/memory_buffer_alloc.h>
static unsigned char heap[56240];
#else
#  error "TODO: no memory buffer configured"
#endif

/*
 * This is the hard-coded root certificate that we accept.
 */
#include "globalsign.inc"

/*
 * Determine the length of an MQTT packet.
 *
 * Returns:
 *   > 0    The length, in bytes, of the MQTT packet this starts
 *   0      We don't have enough data to determine the length.
 *   -errno The packet is malformed.
 */
static int mqtt_length(u8_t *data, size_t len)
{
	u32_t size = 0;
	int shift = 0;
	int pos = 1;

	while (1) {
		if (pos >= 5) {
			return -EINVAL;
		}

		if (pos >= len) {
			return 0;
		}

		u8_t ch = data[pos];

		size |= (ch & 0x7F) << shift;

		if ((ch & 0x80) == 0) {
			break;
		}

		shift += 7;
		pos++;
	}

	return size + pos + 1;
}

static int entropy_source(void *data, unsigned char *output, size_t len,
			  size_t *olen)
{
	u32_t seed;

	// TODO: Don't use sys_rand32_get(), but instead use the
	// entropy device, and fail if it isn't available.

	ARG_UNUSED(data);

	seed = sys_rand32_get();

	if (len > sizeof(seed)) {
		len = sizeof(seed);
	}

	memcpy(output, &seed, len);

	*olen = len;

	return 0;
}

static void my_debug(void *ctx, int level,
		     const char *file, int line, const char *str)
{
	const char *p, *basename;
	int len;

	ARG_UNUSED(ctx);

	/* Extract basename from file */
	for (p = basename = file; *p != '\0'; p++) {
		if (*p == '/' || *p == '\\') {
			basename = p + 1;
		}

	}

	/* Avoid printing double newlines */
	len = strlen(str);
	if (str[len - 1] == '\n') {
		((char *)str)[len - 1] = '\0';
	}

	SYS_LOG_INF("%s:%04d: |%d| %s", basename, line, level, str);
}

static mbedtls_ssl_context the_ssl;
static mbedtls_ssl_config the_conf;
static mbedtls_entropy_context entropy;
static mbedtls_ctr_drbg_context ctr_drbg;
static int sock;

/* State information.  This really should be in a structure per
 * instance. */
static bool got_reply;

static u8_t send_buf[1024];
static u8_t recv_buf[1024];
static size_t recv_used;
static u8_t token[512];

/* A queue of publish replies we need to return. */
#define PUBACK_SIZE 8  /* Change macro if not power of two */
#define INC_PUBACK_Q(x__) (((x__) + 1) & (PUBACK_SIZE - 1))
static u16_t puback_ids[PUBACK_SIZE];
static u16_t puback_head, puback_tail;

/* The next time we should send a keep-alive packet. */
static u64_t next_alive;
#define ALIVE_TIME (60 * MSEC_PER_SEC)

static void process_connack(u8_t *buf, size_t size)
{
	u8_t session;
	u8_t connect_rc;

	int res = mqtt_unpack_connack(buf, size, &session, &connect_rc);
	if (res < 0) {
		SYS_LOG_ERR("Malformed CONNACK received");
		return;
	}

	if (connect_rc != 0) {
		SYS_LOG_ERR("Error establishing connection: %d", connect_rc);
		return;
	}

	printk("Got connack\n");
	got_reply = true;
}

static void process_suback(u8_t *buf, size_t size)
{
	u16_t pkt_id;
	u8_t items;
	enum mqtt_qos granted_qos[4];

	int res = mqtt_unpack_suback(buf, size, &pkt_id,
				     &items, ARRAY_SIZE(granted_qos),
				     granted_qos);
	if (res < 0) {
		SYS_LOG_ERR("Malformed SUBACK message");
		return;
	}

	printk("Got suback: id:%d, items:%d, qos[0]:%d\n",
	       pkt_id, items, granted_qos[0]);
	got_reply = true;
}

static void process_publish(u8_t *buf, size_t size)
{
	struct mqtt_publish_msg incoming_publish;

	int res = mqtt_unpack_publish(buf, size, &incoming_publish);
	if (res < 0) {
		SYS_LOG_ERR("Malformed PUBLISH message");
		return;
	}

	if (incoming_publish.qos != MQTT_QoS1) {
		SYS_LOG_ERR("Unsupported QOS on publish");
		return;
	}

	printk("Got publish: id:%d\n", incoming_publish.pkt_id);

	/* Queue this up. */
	puback_ids[puback_head] = incoming_publish.pkt_id;
	puback_head = INC_PUBACK_Q(puback_head);

	if (puback_head == puback_tail) {
		SYS_LOG_ERR("Too many pub ack replies came in!");
	}
}

static void process_puback(u8_t *buf, size_t size)
{
	u16_t pkt_id;

	int res = mqtt_unpack_puback(buf, size, &pkt_id);
	if (res < 0) {
		SYS_LOG_ERR("Malformed PUBACK message");
		return;
	}

	printk("Got puback: id:%d\n", pkt_id);
	got_reply = true;
}

static void process_packet(u8_t *buf, size_t size)
{
	switch (MQTT_PACKET_TYPE(buf[0])) {
	case MQTT_CONNACK:
		process_connack(buf, size);
		break;
	case MQTT_SUBACK:
		process_suback(buf, size);
		break;
	case MQTT_PUBLISH:
		process_publish(buf, size);
		break;
	case MQTT_PUBACK:
		process_puback(buf, size);
		break;
	case MQTT_PINGRESP:
		printk("Ping response\n");
		break;
	default:
		SYS_LOG_ERR("Unsupported packet received: %x", buf[0]);
		break;
	}
}

static int check_read(mbedtls_ssl_context *context)
{
	int res = mbedtls_ssl_read(context,
				   recv_buf + recv_used,
				   sizeof(recv_buf) - recv_used);
	if (res <= 0) {
		return res;
	}

	recv_used += res;

	int size = mqtt_length(recv_buf, recv_used);
	printk("Read: %d (%d) size=%d\n", res, recv_used, size);

	while (size > 0 && size <= recv_used) {
		if (size > sizeof(recv_buf)) {
			SYS_LOG_ERR("FAILURE: received packet larger than buffer: %d > %d",
				    size, sizeof(recv_buf));
			// TODO: Discard this packet, although there probably
			// isn't really a way to recover from this.
			return res;
		}

		printk("Process packet: %x\n", recv_buf[0]);
		pdump(recv_buf, recv_used);

		process_packet(recv_buf, size);

		/* Consume this part of the buffer, moving any
		 * remaining to the start. */

		if (recv_used > size) {
			memmove(recv_buf, recv_buf + size, recv_used - size);
		}

		recv_used -= size;

		size = mqtt_length(recv_buf, recv_used);
	}

	return res;
}

static int tcp_tx(void *ctx,
		  const unsigned char *buf,
		  size_t len)
{
	int sock = *((int *) ctx);

	/* Ideally, don't try to send more than is allowed.  TLS will
	 * reassemble on the other end. */

//	mbedtls_debug_print_buf(&the_ssl, 4, __FILE__, __LINE__, "tcp_tx", buf, len);
	printf("SEND: %d to %d\n", len, sock);

	int res = zsock_send(sock, buf, len, ZSOCK_MSG_DONTWAIT);
	if (res >= 0) {
		return res;
	}

	if (res != len) {
		printf("Short send: %d\n", res);
	}

	// printk("----- SEND -----\n");
	// pdump(buf, res);
	// printk("----- END SEND -----\n");

	switch errno {
	case EAGAIN:
		printf("Waiting for write, res: %d\n", len);
		return MBEDTLS_ERR_SSL_WANT_WRITE;

	default:
		return MBEDTLS_ERR_NET_SEND_FAILED;
	}
}

static int tcp_rx(void *ctx,
		  unsigned char *buf,
		  size_t len)
{
	int res;
	int sock = *((int *) ctx);

	res = zsock_recv(sock, buf, len, ZSOCK_MSG_DONTWAIT);
//	mbedtls_debug_print_buf(&the_ssl, 4, __FILE__, __LINE__, "tcp_rx", buf, res);
	if (res >= 0) {
		printf("RECV: %d from %d\n", res, sock);
		// printk("----- RECV -----\n");
		// pdump(buf, res);
		// printk("----- END RECV -----\n");
	}

	if (res >= 0) {
		return res;
	}

	switch errno {
	case EAGAIN:
		return MBEDTLS_ERR_SSL_WANT_READ;

	default:
		return MBEDTLS_ERR_NET_RECV_FAILED;
	}
}

const char *pers = "mini_client";  // What is this?

typedef int (*tls_action)(void *data);

/*
 * A driving loop for mbed TLS.  Invokes 'op' with 'data'.  This is
 * expected to return one of the MBEDTLS errors, with
 * MBEDTLS_ERR_SSL_WANT_READ and MBEDTLS_ERR_SSL_WANT_WRITE handled
 * specifically by this code.  This will return when the operation
 * returns any other status result.
 */
static int tls_perform(tls_action action, void *data)
{
	int res = action(data);
	short events = 0;
	while (1) {
		// SYS_LOG_INF("tls_perform loop: %d", res);
		switch (res) {
		case MBEDTLS_ERR_SSL_WANT_READ:
			events = ZSOCK_POLLIN;
			break;

		case MBEDTLS_ERR_SSL_WANT_WRITE:
			events = ZSOCK_POLLOUT;
			break;

		default:
			/* Any other result is directly returned. */
			return res;
		}

		struct zsock_pollfd fds[1] = {
			[0] = {
				.fd = sock,
				.events = events,
				.revents = 0,
			},
		};

		// SYS_LOG_INF("polling: %d", events);
		res = zsock_poll(fds, 1, 250);
		if (res < 0) {
			SYS_LOG_ERR("Socket poll error: %d\n", errno);
			return -errno;
		}

		res = action(data);
	}
}

/* An action to perform the TLS handshaking.  Data should be a pointer
 * to the mbedtls_ssl_context. */
static int action_handshake(void *data)
{
	mbedtls_ssl_context *ssl = data;

	return mbedtls_ssl_handshake(ssl);
}

struct write_action {
	mbedtls_ssl_context *context;
	const unsigned char *buf;
	size_t len;
};

/* An action to write data over the connection.  The data should be a
 * pointer to a struct write_action.  This will also try reading data
 * and processing it as MQTT received data.
 *
 * It is a little complex if we get blocked on both read and write.
 * Currently, this doesn't ever happen (writes don't block in the
 * Zephyr socket code as currently implemented).
 */
static int action_write(void *data)
{
	struct write_action *act = data;

	/* Try the read first, in order to process the received data.
	 */
	int res = check_read(act->context);
	if (res == MBEDTLS_ERR_SSL_WANT_READ ||
		   res == MBEDTLS_ERR_SSL_WANT_WRITE) {
		/* This is kind of the "normal" case of no data being
		 * available. */
	} else if (res < 0) {
		/* Some kind of error, so return that. */
		return res;
	}

	/* At this point, we read, so now try the write. */
	return mbedtls_ssl_write(act->context, act->buf, act->len);
}

struct idle_action {
	mbedtls_ssl_context *context;
};

/* An action when we have nothing to do.  This will try reading, and
 * delay for a single polling interval.  The polling will then allow
 * for other operations to happen.  The main loop will not return
 * unless there is an error. */
static int action_idle(void *data)
{
	struct idle_action *act = data;

	/* If we need to send a keep alive, just return immediately.
	 */
	if (next_alive != 0 && k_uptime_get() >= next_alive) {
		return 1;
	}

	int res = check_read(act->context);
	if (res > 0 && !got_reply && (puback_head == puback_tail)) {
		/* In the valid case, just wait for more data. */
		res = MBEDTLS_ERR_SSL_WANT_READ;
	}

	return res;
}

/*
 * A TLS client, using mbed TLS.
 */
void tls_client(const char *hostname, struct zsock_addrinfo *host, int port)
{
	int res;

	mbedtls_platform_set_time(k_time);

#ifdef MBEDTLS_X509_CRT_PARSE_C
	mbedtls_x509_crt ca;
#else
#	error "Must define MBEDTLS_X509_CRT_PARSE_C"
#endif

	mbedtls_platform_set_printf(PRINT);

	/*
	 * 0. Initialize mbed TLS.
	 */
	mbedtls_ctr_drbg_init(&ctr_drbg);
	mbedtls_ssl_init(&the_ssl);
	mbedtls_ssl_config_init(&the_conf);
	mbedtls_x509_crt_init(&ca);

	SYS_LOG_INF("Seeding the random number generator...");
	mbedtls_entropy_init(&entropy);
	mbedtls_entropy_add_source(&entropy, entropy_source, NULL,
				   MBEDTLS_ENTROPY_MAX_GATHER,
				   MBEDTLS_ENTROPY_SOURCE_STRONG);

	if (mbedtls_ctr_drbg_seed(&ctr_drbg, mbedtls_entropy_func, &entropy,
				  (const unsigned char *)pers,
				  strlen(pers)) != 0) {
		SYS_LOG_ERR("Unable to init drbg");
		return;
	}

	SYS_LOG_INF("Setting up the TLS structure");
	if (mbedtls_ssl_config_defaults(&the_conf,
					MBEDTLS_SSL_IS_CLIENT,
					MBEDTLS_SSL_TRANSPORT_STREAM,
					MBEDTLS_SSL_PRESET_DEFAULT) != 0) {
		SYS_LOG_ERR("Unable to setup ssl config");
		return;
	}

	mbedtls_ssl_conf_dbg(&the_conf, my_debug, NULL);

	mbedtls_ssl_conf_rng(&the_conf, mbedtls_ctr_drbg_random, &ctr_drbg);

	/* MBEDTLS_MEMORY_BUFFER_ALLOC_C */
	mbedtls_memory_buffer_alloc_init(heap, sizeof(heap));

	/*
	 * Never disable root cert verification, like this.
	 */
#if 1
	/* Load the intended root cert in. */
	if (mbedtls_x509_crt_parse_der(&ca, globalsign_certificate,
				       sizeof(globalsign_certificate)) != 0) {
		SYS_LOG_ERR("Unable to decode root cert");
		return;
	}

	/* And configure tls to require the other side of the
	 * connection to use a cert signed by this certificate.
	 * This makes things fragile, as we are tied to a specific
	 * certificate. */
	mbedtls_ssl_conf_ca_chain(&the_conf, &ca, NULL);
	mbedtls_ssl_conf_authmode(&the_conf, MBEDTLS_SSL_VERIFY_REQUIRED);
#else
	mbedtls_ssl_conf_authmode(&the_conf, MBEDTLS_SSL_VERIFY_NONE);
#endif

	// mbedtls_debug_set_threshold(2);
	if (mbedtls_ssl_setup(&the_ssl, &the_conf) != 0) {
		SYS_LOG_ERR("Error running mbedtls_ssl_setup");
		return;
	}

	/* Certificate verification requires matching against an
	 * expected hostname.  Use the one we looked up.
	 * TODO: Make this only occur once in the code.
	 */
	if (mbedtls_ssl_set_hostname(&the_ssl, hostname) != 0) {
		SYS_LOG_ERR("Error setting target hostname");
	}

	SYS_LOG_INF("tls init done");

	SYS_LOG_INF("Connecting to tcp '%s'", hostname);
	SYS_LOG_INF("Creating socket");
	sock = zsock_socket(AF_INET, SOCK_STREAM, IPPROTO_TCP);
	if (sock == -1) {
		SYS_LOG_ERR("Failed to create socket");
		return;
	}

	SYS_LOG_INF("connecting...");
	res = zsock_connect(sock, host->ai_addr, host->ai_addrlen);
	if (res == -1) {
		SYS_LOG_ERR("Failed to connect to socket");
		return;
	}
	SYS_LOG_INF("Connected");

	mbedtls_ssl_set_bio(&the_ssl, &sock, tcp_tx, tcp_rx, NULL);

	SYS_LOG_INF("Performing TLS handshake");
	SYS_LOG_INF("State: %d", the_ssl.state);
	// mbedtls_debug_set_threshold(2);

	res = tls_perform(action_handshake, &the_ssl);
	if (res != 0) {
		SYS_LOG_INF("Error on tls handshake: %d", res);
		return;
	}
	if (the_ssl.state != MBEDTLS_SSL_HANDSHAKE_OVER) {
		SYS_LOG_INF("SSL handshake did not complete: %d", the_ssl.state);
		return;
	}

	SYS_LOG_ERR("Done with TCP client startup");
}

//extern const unsigned char zepfull_private_der[];
//extern const unsigned int zepfull_private_der_len;

//extern const unsigned char zepfull_ec_private_der[];
//extern const unsigned int zepfull_ec_private_der_len;

static const char client_id[] = "projects/macro-precinct-211108/locations/us-central1/"
		"registries/agross-registry/devices/agross";
#define AUDIENCE "macro-precinct-211108"

#if 0
static void show_stack(void)
{
	static bool once = false;

	extern u8_t _main_stack[];

	if (!once) {
		once = true;
		// pdump(_main_stack, CONFIG_MAIN_STACK_SIZE);
		// pdump(heap, sizeof(heap));
		mbedtls_memory_buffer_alloc_status();
	}
}
#endif

void mqtt_startup(void)
{
	struct mqtt_connect_msg conmsg;
	struct jwt_builder jb;

	time_t now = k_time(NULL);

	int res = jwt_init_builder(&jb, token, sizeof(token));
	if (res != 0) {
		printk("Error with JWT token\n");
		return;
	}

	res = jwt_add_payload(&jb, now + 60 * 60, now,
			      AUDIENCE);
	if (res != 0) {
		printk("Error with JWT token\n");
		return;
	}

#ifdef CONFIG_JWT_SIGN_RSA
	res = jwt_sign(&jb, zepfull_private_der, zepfull_private_der_len);
#endif
#ifdef CONFIG_JWT_SIGN_ECDSA
	res = jwt_sign(&jb, zepfull_ec_private_der, zepfull_ec_private_der_len);
#endif
	if (res != 0) {
		printk("Error with JWT token\n");
		return;
	}

	memset(&conmsg, 0, sizeof(conmsg));

	conmsg.clean_session = 1;
	conmsg.client_id = (char *)client_id;  /* Discard const */
	conmsg.client_id_len = strlen(client_id);
	conmsg.keep_alive = 60 * 2; /* Two minutes */
	conmsg.password = token;
	conmsg.password_len = jwt_payload_len(&jb);

	printk("len1 = %d, len2 = %d\n", conmsg.password_len,
	       strlen(token));

	u16_t send_len = 0;
	res = mqtt_pack_connect(send_buf, &send_len, sizeof(send_buf),
				    &conmsg);
	printk("build packet: res = %d, len=%d\n", res, send_len);

	struct write_action wract = {
		.context = &the_ssl,
		.buf = send_buf,
		.len = send_len,
	};

	pdump(send_buf, send_len);
	res = tls_perform(action_write, &wract);

	while (!got_reply) {
		printk("Waiting for CONNACT\n");
		struct idle_action idact = {
			.context = &the_ssl,
		};

		res = tls_perform(action_idle, &idact);
		if (res <= 0) {
			printk("Idle error: %d\n", res);
			return;
		}
	}

	printk("Done with connect\n");
	got_reply = false;

#if 1
	/* Try subscribing to the device state message. */
	static const char *topics[] = {
		"/devices/agross/config",
	};
	static const enum mqtt_qos qoss[] = {
		MQTT_QoS1,
	};
	res = mqtt_pack_subscribe(send_buf, &send_len, sizeof(send_buf),
				  124, 1, topics, qoss);
	printk("Subscribe packet: res=%d, len=%d\n", res, send_len);
#else
#define TOPIC "/devices/zepfull/state"
#define MESSAGE "Some more state"
	/* Try sending a state update. */
	struct mqtt_publish_msg pmsg = {
		.dup = 0,
		.qos = MQTT_QoS1,
		.retain = 1,
		.pkt_id = 0xfd12,
		.topic = TOPIC,
		.topic_len = strlen(TOPIC),
		.msg = MESSAGE,
		.msg_len = strlen(MESSAGE),
	};
	res = mqtt_pack_publish(send_buf, &send_len, sizeof(send_buf),
				&pmsg);
	printk("Publish packet: res=%d, len=%d\n", res, send_len);
#endif
	wract.buf = send_buf;
	wract.len = send_len;
	pdump(send_buf, send_len);
	res = tls_perform(action_write, &wract);
	printk("Send result: %d\n", res);
	if (res < 0) {
		return;
	}
	if (res != send_len) {
		printk("Short send\n");
	}

#if 0
	while (!got_reply) {
		printk("Waiting for SUBACK\n");
		struct idle_action idact = {
			.context = &the_ssl,
		};

		res = tls_perform(action_idle, &idact);
		if (res <= 0) {
			printk("Idle error: %d\n", res);
			return;
		}
	}
#endif

	got_reply = 0;

	next_alive = k_uptime_get() + ALIVE_TIME;

	while (1) {
		struct idle_action idact = {
			.context = &the_ssl,
		};

		res = tls_perform(action_idle, &idact);
		if (res <= 0) {
			printk("Idle error: %d\n", res);
			return;
		}

		while (puback_head != puback_tail) {
			printk("head=%d, tail=%d\n", puback_head, puback_tail);
			/* Send the puback back so that the remote
			 * feels we have received the message. */
			res = mqtt_pack_puback(send_buf, &send_len, sizeof(send_buf),
					       puback_ids[puback_tail]);
			printk("Send Puback: res=%d, len=%d\n", res, send_len);

			puback_tail = INC_PUBACK_Q(puback_tail);

			wract.buf = send_buf;
			wract.len = send_len;
			pdump(send_buf, send_len);
			res = tls_perform(action_write, &wract);

			if (res != send_len) {
				SYS_LOG_ERR("Problem sending PUBACK: %d", res);
			}

			next_alive = k_uptime_get() + ALIVE_TIME;
		}

		if (k_uptime_get() >= next_alive) {
			res = mqtt_pack_pingreq(send_buf, &send_len, sizeof(send_buf));
			printk("Send ping, res=%d, len=%d\n", res, send_len);

			wract.buf = send_buf;
			wract.len = send_len;
			pdump(send_buf, send_len);
			res = tls_perform(action_write, &wract);

			if (res != send_len) {
				SYS_LOG_ERR("Problem sending ping: %d", res);
			}

			next_alive = k_uptime_get() + ALIVE_TIME;

			// show_stack();
		}
	}
}
```

## src/protocol.h
```c
/*
 * Copyright (c) 2018 Linaro Ltd
 *
 * SPDX-License-Identifier: Apache-2.0
 */

/*
 * MQTT-based cloud protocol engine.
 */

#ifndef PROTOCOL_H__
#define PROTOCOL_H__

#include <net/socket.h>

void tls_client(const char *hostname, struct zsock_addrinfo *host, int port);
void mqtt_startup(void);

#endif
```

## src/tcp.c
```c
/*
 * Copyright (c) 2016 Intel Corporation
 * Copyright (c) 2018 Linaro Ltd
 *
 * SPDX-License-Identifier: Apache-2.0
 */

#define SYS_LOG_LEVEL SYS_LOG_LEVEL_DEBUG

#include <logging/sys_log.h>
#include <string.h>
#include <errno.h>
#include <misc/printk.h>

#include "tcp.h"

#include <net/net_core.h>
#include <net/net_context.h>
#include <net/net_pkt.h>
#include <net/net_if.h>

#ifndef CONFIG_MBEDTLS_CFG_FILE
# include "mbedtls/config.h"
#else
# include CONFIG_MBEDTLS_CFG_FILE
#endif

#include <mbedtls/ssl.h>

#define INET_FAMILY AF_INET

#define TCP_BUF_CTR 5
#define TCP_BUF_SIZE 1024

NET_BUF_POOL_DEFINE(tcp_msg_pool, TCP_BUF_CTR, TCP_BUF_SIZE, 0, NULL);

int tcp_tx(void *context, const unsigned char *buf, size_t size)
{
	SYS_LOG_ERR("tcp_tx");
	return -1;
}

int tcp_rx(void *context, unsigned char *buf, size_t size)
{
	SYS_LOG_ERR("tcp_rx");
	return -1;
}

static int set_addr(struct sockaddr *sock_addr, const char *addr,
		    u16_t server_port)
{
	void *ptr = NULL;
	int rc;

#ifdef CONFIG_NET_IPV6
	net_sin6(sock_addr)->sin6_port = htons(server_port);
	sock_addr->sa_family = AF_INET6;
	ptr = &(net_sin6(sock_addr)->sin6_addr);
	rc = net_addr_pton(AF_INET6, addr, ptr);
#else
	net_sin(sock_addr)->sin_port = htons(server_port);
	sock_addr->sa_family = AF_INET;
	ptr = &(net_sin(sock_addr)->sin_addr);
	rc = net_addr_pton(AF_INET, addr, ptr);
#endif

	if (rc) {
		SYS_LOG_ERR("Invalid IP address: %s", addr);
	}

	return rc;
}

int tcp_init(struct tcp_context *ctx, const char *server_addr,
	     u16_t server_port)
{
	struct sockaddr server_sock;
	int rc;

#ifdef CONFIG_NET_IPV6
	socklen_t addr_len = sizeof(struct sockaddr_in6);
	sa_family_t family = AF_INET6;
#else
	socklen_t addr_len = sizeof(struct sockaddr_in);
	sa_family_t family = AF_INET;
#endif

	rc = net_context_get(family, SOCK_STREAM, IPPROTO_TCP, &ctx->net_ctx);
	if (rc) {
		SYS_LOG_ERR("net_context_get error: %d", rc);
		return rc;
	}

	rc = set_addr(&server_sock, server_addr, server_port);
	if (rc) {
		SYS_LOG_ERR("set_addr error");
		goto lb_exit;
	}

	rc = net_context_connect(ctx->net_ctx, &server_sock, addr_len, NULL,
				 ctx->timeout, NULL);
	if (rc) {
		SYS_LOG_ERR("net_context_connect error");
		goto lb_exit;
	}

	return 0;

lb_exit:
	net_context_put(ctx->net_ctx);

	return rc;
}
```

## src/tcp.h
```c
/*
 * Copyright (c) 2016 Intel Corporation
 * Copyright (c) 2018 Linaro Ltd
 *
 * SPDX-License-Identifier: Apache-2.0
 */

#ifndef __TCP_H__
#define __TCP_H__

#include <net/net_context.h>
#include <net/net_ip.h>
#include <net/net_pkt.h>

struct tcp_context {
	struct net_context *net_ctx;
	struct sockaddr local_sock;
	struct net_pkt *rx_pkt;
	s32_t timeout;
};

int tcp_init(struct tcp_context *ctx, const char *server_addr,
	     u16_t server_port);

int tcp_tx(void *ctx, const unsigned char *buf, size_t size);
int tcp_rx(void *ctx, unsigned char *buf, size_t size);

#endif /* not __TCP_H__ */
```

## src/zepfull-cert.c
```c
/* subject:/CN=zepfull */
/* issuer :/CN=zepfull */
/*
unsigned char XXX_subject_name[20]={
0x30,0x12,0x31,0x10,0x30,0x0E,0x06,0x03,0x55,0x04,0x03,0x0C,0x07,0x7A,0x65,0x70,
0x66,0x75,0x6C,0x6C,
};
unsigned char XXX_public_key[294]={
0x30,0x82,0x01,0x22,0x30,0x0D,0x06,0x09,0x2A,0x86,0x48,0x86,0xF7,0x0D,0x01,0x01,
0x01,0x05,0x00,0x03,0x82,0x01,0x0F,0x00,0x30,0x82,0x01,0x0A,0x02,0x82,0x01,0x01,
0x00,0x9E,0xF9,0x97,0x8E,0xB0,0x12,0x33,0x1C,0xAA,0x8A,0x4E,0x08,0x53,0xCB,0xD2,
0x62,0x3F,0x1D,0xB8,0x88,0x21,0x5C,0x8E,0x1C,0x2E,0x4D,0x35,0x87,0x7A,0xF6,0x8F,
0xA5,0x21,0xFF,0x23,0x10,0xBB,0x4A,0x3B,0xDC,0x2C,0x3C,0x9B,0x6A,0x79,0x15,0xFA,
0x95,0x09,0xB2,0xB4,0xFD,0xC8,0xC0,0xF6,0x09,0xA3,0xEB,0xB7,0xD0,0xD5,0xFE,0x54,
0xCA,0x39,0x2F,0x81,0x36,0xA2,0xC2,0x20,0x64,0x16,0xF3,0x71,0x00,0x47,0xF8,0xBD,
0xE6,0x89,0xD3,0xF9,0x81,0x76,0xAB,0xDD,0xA7,0x61,0x9B,0x59,0xB9,0x14,0xC5,0x75,
0x3F,0x43,0x83,0x5A,0x73,0xDD,0xAF,0x9E,0x5D,0xAB,0x09,0xDE,0x3E,0xCF,0xA6,0x0A,
0x5A,0x7F,0xC8,0x1D,0xC9,0x9C,0xDD,0x52,0x5E,0x63,0x52,0x6B,0x15,0xE6,0xCE,0xA2,
0x98,0x88,0x27,0xF8,0x2E,0xBD,0xB9,0xA4,0xC8,0x50,0xBF,0x20,0x1F,0xE5,0x41,0x2D,
0x78,0xF1,0x8D,0x62,0x01,0x37,0xFE,0xC9,0xCC,0x59,0xE6,0x99,0x2D,0x7C,0x4B,0x76,
0xB2,0x65,0x58,0xC8,0xCC,0x65,0x78,0xE8,0x38,0x51,0xED,0xCD,0x3B,0xC4,0x08,0x24,
0xA4,0x40,0xF3,0xAA,0x3A,0xEA,0xED,0x83,0x59,0x58,0x22,0xFE,0x40,0x3E,0xBB,0xC7,
0x74,0x8C,0x4C,0xBC,0x93,0xBF,0x03,0x6E,0x16,0x97,0xCC,0xB5,0xFF,0x30,0x28,0x45,
0x8D,0xCD,0x46,0xEC,0x8A,0x24,0xCC,0xD5,0x45,0x41,0x53,0x22,0x15,0x4B,0x2D,0x45,
0xD9,0x01,0xDF,0x98,0x80,0xAA,0x26,0x09,0x80,0xF5,0xF2,0x27,0xAE,0x53,0xB8,0x64,
0x3B,0x41,0xA9,0x13,0xF7,0x43,0xFB,0x59,0xC5,0xB0,0xFD,0x41,0x3A,0xFE,0x02,0x45,
0x71,0x02,0x03,0x01,0x00,0x01,
};
*/
unsigned char zepfull_certificate[765]={
0x30,0x82,0x02,0xF9,0x30,0x82,0x01,0xE1,0xA0,0x03,0x02,0x01,0x02,0x02,0x09,0x00,
0xFD,0x44,0x27,0x18,0x17,0x77,0x33,0x9F,0x30,0x0D,0x06,0x09,0x2A,0x86,0x48,0x86,
0xF7,0x0D,0x01,0x01,0x0B,0x05,0x00,0x30,0x12,0x31,0x10,0x30,0x0E,0x06,0x03,0x55,
0x04,0x03,0x0C,0x07,0x7A,0x65,0x70,0x66,0x75,0x6C,0x6C,0x30,0x20,0x17,0x0D,0x31,
0x38,0x30,0x37,0x30,0x32,0x31,0x36,0x33,0x32,0x32,0x33,0x5A,0x18,0x0F,0x34,0x37,
0x35,0x36,0x30,0x35,0x32,0x39,0x31,0x36,0x33,0x32,0x32,0x33,0x5A,0x30,0x12,0x31,
0x10,0x30,0x0E,0x06,0x03,0x55,0x04,0x03,0x0C,0x07,0x7A,0x65,0x70,0x66,0x75,0x6C,
0x6C,0x30,0x82,0x01,0x22,0x30,0x0D,0x06,0x09,0x2A,0x86,0x48,0x86,0xF7,0x0D,0x01,
0x01,0x01,0x05,0x00,0x03,0x82,0x01,0x0F,0x00,0x30,0x82,0x01,0x0A,0x02,0x82,0x01,
0x01,0x00,0x9E,0xF9,0x97,0x8E,0xB0,0x12,0x33,0x1C,0xAA,0x8A,0x4E,0x08,0x53,0xCB,
0xD2,0x62,0x3F,0x1D,0xB8,0x88,0x21,0x5C,0x8E,0x1C,0x2E,0x4D,0x35,0x87,0x7A,0xF6,
0x8F,0xA5,0x21,0xFF,0x23,0x10,0xBB,0x4A,0x3B,0xDC,0x2C,0x3C,0x9B,0x6A,0x79,0x15,
0xFA,0x95,0x09,0xB2,0xB4,0xFD,0xC8,0xC0,0xF6,0x09,0xA3,0xEB,0xB7,0xD0,0xD5,0xFE,
0x54,0xCA,0x39,0x2F,0x81,0x36,0xA2,0xC2,0x20,0x64,0x16,0xF3,0x71,0x00,0x47,0xF8,
0xBD,0xE6,0x89,0xD3,0xF9,0x81,0x76,0xAB,0xDD,0xA7,0x61,0x9B,0x59,0xB9,0x14,0xC5,
0x75,0x3F,0x43,0x83,0x5A,0x73,0xDD,0xAF,0x9E,0x5D,0xAB,0x09,0xDE,0x3E,0xCF,0xA6,
0x0A,0x5A,0x7F,0xC8,0x1D,0xC9,0x9C,0xDD,0x52,0x5E,0x63,0x52,0x6B,0x15,0xE6,0xCE,
0xA2,0x98,0x88,0x27,0xF8,0x2E,0xBD,0xB9,0xA4,0xC8,0x50,0xBF,0x20,0x1F,0xE5,0x41,
0x2D,0x78,0xF1,0x8D,0x62,0x01,0x37,0xFE,0xC9,0xCC,0x59,0xE6,0x99,0x2D,0x7C,0x4B,
0x76,0xB2,0x65,0x58,0xC8,0xCC,0x65,0x78,0xE8,0x38,0x51,0xED,0xCD,0x3B,0xC4,0x08,
0x24,0xA4,0x40,0xF3,0xAA,0x3A,0xEA,0xED,0x83,0x59,0x58,0x22,0xFE,0x40,0x3E,0xBB,
0xC7,0x74,0x8C,0x4C,0xBC,0x93,0xBF,0x03,0x6E,0x16,0x97,0xCC,0xB5,0xFF,0x30,0x28,
0x45,0x8D,0xCD,0x46,0xEC,0x8A,0x24,0xCC,0xD5,0x45,0x41,0x53,0x22,0x15,0x4B,0x2D,
0x45,0xD9,0x01,0xDF,0x98,0x80,0xAA,0x26,0x09,0x80,0xF5,0xF2,0x27,0xAE,0x53,0xB8,
0x64,0x3B,0x41,0xA9,0x13,0xF7,0x43,0xFB,0x59,0xC5,0xB0,0xFD,0x41,0x3A,0xFE,0x02,
0x45,0x71,0x02,0x03,0x01,0x00,0x01,0xA3,0x50,0x30,0x4E,0x30,0x1D,0x06,0x03,0x55,
0x1D,0x0E,0x04,0x16,0x04,0x14,0x07,0x36,0x89,0x05,0x2B,0x2D,0xB5,0xBB,0xE1,0xD0,
0x09,0x78,0xF7,0x74,0xA9,0x78,0x80,0xD2,0x55,0x0B,0x30,0x1F,0x06,0x03,0x55,0x1D,
0x23,0x04,0x18,0x30,0x16,0x80,0x14,0x07,0x36,0x89,0x05,0x2B,0x2D,0xB5,0xBB,0xE1,
0xD0,0x09,0x78,0xF7,0x74,0xA9,0x78,0x80,0xD2,0x55,0x0B,0x30,0x0C,0x06,0x03,0x55,
0x1D,0x13,0x04,0x05,0x30,0x03,0x01,0x01,0xFF,0x30,0x0D,0x06,0x09,0x2A,0x86,0x48,
0x86,0xF7,0x0D,0x01,0x01,0x0B,0x05,0x00,0x03,0x82,0x01,0x01,0x00,0x3B,0xB6,0x1B,
0x37,0x87,0xDB,0x92,0x99,0x87,0xE0,0xB8,0x0F,0x4A,0xA7,0x3C,0xCF,0x40,0x76,0x6C,
0xD7,0xEF,0x26,0xDF,0x95,0x54,0x43,0x17,0x91,0x8B,0x88,0xEE,0xD0,0x44,0x77,0xBB,
0x1F,0x65,0x54,0xEF,0x1F,0x42,0x93,0x95,0xF7,0x7C,0xC5,0x36,0x1A,0x69,0x36,0x7A,
0x25,0x30,0x66,0x3E,0x86,0xCE,0x69,0xFF,0xA9,0xC6,0xA9,0x7F,0x24,0xB6,0x97,0xA5,
0xE2,0x15,0xFF,0xEC,0xDC,0x42,0x8F,0x25,0x08,0xF6,0x80,0x69,0x86,0xFF,0x39,0xC9,
0x12,0x21,0x37,0xD8,0xD4,0x67,0x12,0x46,0x7C,0xFB,0x51,0x9E,0x6F,0x21,0x71,0x95,
0x7B,0xA0,0xE9,0x5D,0xCD,0xB5,0x89,0x70,0xF9,0x72,0x36,0x14,0x5F,0x28,0x91,0x94,
0x7D,0x10,0x96,0x09,0x0E,0xB9,0x4D,0xDD,0x2F,0x24,0x08,0x01,0xDC,0x62,0x27,0x77,
0xFD,0x17,0x86,0xD1,0x6E,0x7D,0x74,0x77,0x1F,0x4E,0xE5,0xD7,0xC3,0x1C,0xCB,0x03,
0x4F,0xEB,0x26,0xEE,0x74,0xC2,0x88,0xDD,0xF1,0x76,0xDA,0x32,0x5F,0xBF,0xAF,0x34,
0x18,0x8D,0x1A,0x17,0x3F,0xF7,0x60,0x16,0x2B,0xFD,0x0F,0x76,0x60,0x21,0x9E,0x7F,
0x3A,0x9C,0x2A,0xCD,0x43,0xDC,0x58,0xEC,0x75,0xA2,0x48,0x91,0x0A,0x75,0x82,0x20,
0x87,0x1C,0xE0,0xD7,0xA4,0x9C,0x19,0x81,0xF6,0x5F,0x8C,0x5A,0x62,0x9C,0x3E,0xBA,
0x70,0xD0,0x89,0xDF,0x0B,0x77,0x3F,0x1D,0x67,0xD6,0x70,0x25,0x97,0x44,0xF9,0xCD,
0xB2,0xBB,0xE5,0x18,0x04,0x5B,0x55,0x3E,0xA7,0xD6,0x64,0xDF,0xAF,0x3A,0xD2,0x5E,
0xC5,0xF0,0x87,0xF4,0x42,0x65,0xC9,0x36,0x93,0x8F,0x3D,0xA7,0x7F,
};
```
