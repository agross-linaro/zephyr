## arch/arm/soc/arm/mps2/Kconfig.defconfig.mps2_an521
```kconfig
#
# Copyright (c) 2018 Arm Limited
#
# SPDX-License-Identifier: Apache-2.0
#

if SOC_MPS2_AN521

config BUILD_OUTPUT_HEX
	default y

config SOC
	default "mps2_an521"

config NUM_IRQS
	int
	default 96

endif
```

## arch/arm/soc/ti_lm3s6965/Kconfig.soc
```kconfig
config SOC_TI_LM3S6965
	bool "TI LM3S6965"
	select CPU_CORTEX_M
	select CPU_CORTEX_M3
	select CPU_HAS_SYSTICK

if SOC_TI_LM3S6965
config SOC_FAMILY
	string
	default ti_lm3s6965
endif
```

## drivers/jwt/Kconfig
```kconfig
# This is a hack.

menuconfig JWT
	bool
	prompt "Enable JWT token generation"
	select JSON_LIBRARY
	default n
	help
	  Enable creation of JWT tokens

if JWT
choice
	prompt "JWT signature algorithm"
	default JWT_SIGN_RSA
	help
	  Select which algorithm to use for signing JWT tokens.

config JWT_SIGN_RSA
	bool "Use RSA signature (RS-256)"
	select MBEDTLS

config JWT_SIGN_ECDSA
	bool "Use ECDSA signature (ES-256)"
	select TINYCRYPT
	select TINYCRYPT_SHA256
	select TINYCRYPT_ECC_DSA
	select TINYCRYPT_CTR_PRNG
	select TINYCRYPT_AES

endchoice
endif
```

## drivers/spi/Kconfig.cadence
```kconfig
# Kconfig - Cadence SPI
#
# Copyright (c) 2018 Linaro Lmtd
# SPDX-License-Identifier: Apache-2.0

menuconfig SPI_CADENCE
	bool "Cadence SPI Driver"
	select HAS_DTS_SPI
	default y
	help
	  Enable support for the Cadence SPI driver.
```

## drivers/wifi/esp8266/Kconfig.esp8266
```kconfig
menuconfig WIFI_ESP8266
	bool "ESP8266 driver support"
	default y
	depends on WIFI
	depends on SERIAL
	select WIFI_OFFLOAD
	select NET_L2_WIFI_MGMT

if WIFI_ESP8266

config WIFI_ESP8266_UART_DEVICE
	string "Serial device used for ESP8266 connection"
	default "UART_1"
	help
	Specify the device name of the serial device to which ESP8266 is
	connected.

config WIFI_ESP8266_GPIO_DEVICE
	string "GPIO driver's name to use to drive ESP8266 enable"
	default "GPIO_1"
	help
	  This option is mandatory to set which GPIO controller to use in
	  order to drive the enable pin

config WIFI_ESP8266_HAS_ENABLE_PIN
	bool "ESP8266 device uses an enable pin"
	default n
	help
	  This option defines whether or not the ESP8266 device utilizes a
	  enable pin

if WIFI_ESP8266_HAS_ENABLE_PIN
config WIFI_ESP8266_GPIO_ENABLE_PIN
	int "GPIO PIN to use to drive ESP8266 enable"
	help
	  This option is mandatory to set which GPIO pin to use in order
	  to enable the ESP8266
endif

config WIFI_ESP8266_BAUD_RATE
	int "Baud rate used for communication to ESP8266"
	default 9600
	help
	This option defines the baud rate used for communication to/from
	the ESP8266

endif
```

## dts/bindings/serial/arm,scc.yaml
```yaml
---
title: ARM Serial Configuration Control
id: arm,scc
version: 0.1

description: >
    This binding gives a base representation of the ARM SCC

properties:
    compatible:
      type: string
      category: required
      description: compatible strings
      constraint: "arm,scc"

    reg:
      type: array
      description: mmio register space
      generation: define
      category: required

...
```

## dts/bindings/spi/cadence,spi.yaml
```yaml
#
# Copyright (c) 2018, Linaro Lmtd
#
# SPDX-License-Identifier: Apache-2.0
#
---
title: Cadence SPI
id: cadence,spi
version: 0.1

description: >
    This binding gives a base representation of the Cadence SPI IP

inherits:
    !include spi.yaml

properties:
    compatible:
      type: string
      category: required
      description: compatible strings
      constraint: "cadence,spi"

    reg:
      type: array
      description: mmio register space
      generation: define
      category: required

    interrupts:
      type: array
      category: required
      description: required interrupts
      generation: define
...
```
